## CMakeLists.txt
```
# SPDX-License-Identifier: Apache-2.0

cmake_minimum_required(VERSION 3.20.0)

LIST(APPEND QEMU_EXTRA_FLAGS -serial unix:/tmp/bt-stack-tester)

find_package(Zephyr REQUIRED HINTS $ENV{ZEPHYR_BASE})
project(tester)

zephyr_library_include_directories(${ZEPHYR_BASE}/samples/bluetooth)
zephyr_library_include_directories(${ZEPHYR_BASE}/subsys/bluetooth/mesh)
zephyr_library_include_directories(${ZEPHYR_BASE}/subsys/bluetooth/host)
target_sources(app PRIVATE
    src/main.c
    src/btp.c
    src/btp_core.c
    src/btp_gap.c
    src/btp_gatt.c
    )
if(CONFIG_BT_L2CAP_DYNAMIC_CHANNEL)
target_sources(app PRIVATE src/btp_l2cap.c)
endif()

if(CONFIG_BT_MESH)
target_sources(app PRIVATE src/btp_mesh.c)
endif()

if(CONFIG_BT_IAS OR CONFIG_BT_IAS_CLIENT)
target_sources(app PRIVATE src/btp_ias.c)
endif()

if(CONFIG_BT_OTS)
    target_sources(app PRIVATE src/btp_ots.c)
endif()

if(CONFIG_BT_BPS)
    target_sources(app PRIVATE src/btp_bps.c)
endif()

if(CONFIG_BT_WSS)
    target_sources(app PRIVATE src/btp_wss.c)
endif()

if(CONFIG_BT_SPS)
    target_sources(app PRIVATE src/btp_sps.c)
endif()

zephyr_library_include_directories(src src/btp src/audio/btp)
add_subdirectory_ifdef(CONFIG_BT_AUDIO src/audio)
```

## prj.conf
```kconfig
# ==========================================
# Bluetooth Tester (BTP) configuration
# ==========================================

# --- Bluetooth stack ---
CONFIG_BT=y
CONFIG_BT_CENTRAL=y
CONFIG_BT_PERIPHERAL=y
CONFIG_BT_PRIVACY=n
CONFIG_BT_SMP=y
CONFIG_BT_SMP_ENFORCE_MITM=n
CONFIG_BT_SMP_ALLOW_UNAUTH_OVERWRITE=y
CONFIG_BT_SMP_APP_PAIRING_ACCEPT=y
CONFIG_BT_SIGNING=n
CONFIG_BT_BONDABLE=y
CONFIG_BT_ATT_PREPARE_COUNT=12
CONFIG_BT_GATT_CLIENT=y
CONFIG_BT_L2CAP_DYNAMIC_CHANNEL=y
CONFIG_BT_DEVICE_NAME="Tester"
CONFIG_BT_DEVICE_NAME_MAX=32
CONFIG_BT_DEVICE_NAME_DYNAMIC=y
CONFIG_BT_DEVICE_NAME_GATT_WRITABLE=y
CONFIG_BT_EATT=y
CONFIG_BT_L2CAP_ECRED=y
CONFIG_BT_EATT_MAX=5
CONFIG_BT_FILTER_ACCEPT_LIST=y
CONFIG_BT_EATT_AUTO_CONNECT=n
CONFIG_BT_MAX_CONN=1
CONFIG_BT_MAX_PAIRED=1
CONFIG_BT_GATT_NOTIFY_MULTIPLE=y
CONFIG_BT_ATT_RETRY_ON_SEC_ERR=n
CONFIG_BT_GATT_DYNAMIC_DB=y
CONFIG_BT_EXT_ADV=y
CONFIG_BT_PER_ADV=y
CONFIG_BT_PER_ADV_SYNC=y
CONFIG_BT_BUF_ACL_RX_SIZE=100
CONFIG_BT_RX_STACK_SIZE=4096
CONFIG_BT_TESTING=y
CONFIG_BT_OTS=n
CONFIG_BT_BPS=y
CONFIG_BT_WSS=y
CONFIG_BT_SPS=y

CONFIG_UTF8=y

# --- UART / BTP transport ---
# uart-pipe carries the binary BTP protocol; the console subsystem
# MUST be completely off so nothing else writes to the same UART.
CONFIG_SERIAL=y
CONFIG_UART_INTERRUPT_DRIVEN=y
CONFIG_UART_PIPE=y

# Disable every form of console output — the single UART is reserved
# for BTP and any stray text will corrupt the binary protocol.
CONFIG_CONSOLE=n
CONFIG_UART_CONSOLE=n
CONFIG_STDOUT_CONSOLE=n
CONFIG_PRINTK=n
CONFIG_EARLY_CONSOLE=n
CONFIG_BOOT_BANNER=n

# --- Logging / Debug ---
CONFIG_LOG=n
CONFIG_ASSERT=n
CONFIG_USE_SEGGER_RTT=n
CONFIG_RTT_CONSOLE=n

# --- System ---
CONFIG_SYSTEM_WORKQUEUE_STACK_SIZE=2048
CONFIG_TEST_RANDOM_GENERATOR=y
```

## boards/lp_em_cc2340r53.conf
```kconfig
# Board-specific overrides for BTP tester on LP_EM_CC2340R53
#
# The board defconfig enables PM and console; both must be disabled
# for reliable BTP communication over the single UART.

# Disable power management — PM can suspend the UART during idle,
# causing BTP timeouts.
CONFIG_PM=n
CONFIG_PM_DEVICE=n

# The board defconfig enables console; force it off here so the
# overlay's uart-pipe has exclusive ownership of uart0.
CONFIG_CONSOLE=n
CONFIG_UART_CONSOLE=n

# Required by uart-pipe
CONFIG_UART_INTERRUPT_DRIVEN=y

# The board defconfig enables MBEDTLS and CTR_DRBG, which require an
# entropy source on CC23x0.
CONFIG_ENTROPY_GENERATOR=y
```

## boards/lp_em_cc2340r5.overlay
```dts
/*
 * BTP tester overlay for TI LP_EM_CC2340R5
 *
 * Same as cc2340r53 — single UART used exclusively for BTP.
 */

/ {
	chosen {
		zephyr,uart-pipe = &uart0;
		/delete-property/ zephyr,console;
		/delete-property/ zephyr,shell-uart;
	};
};
```

## boards/lp_em_cc2340r53.overlay
```dts
/*
 * BTP tester overlay for TI LP_EM_CC2340R53
 *
 * The CC2340R53 has only one UART (uart0). It must be used exclusively
 * for BTP (uart-pipe). Console output MUST be disabled in Kconfig to
 * prevent text from corrupting the BTP binary protocol stream.
 *
 * Do NOT assign zephyr,console or zephyr,shell-uart here — the console
 * subsystem is disabled via the board .conf file.
 */

/ {
	chosen {
		zephyr,uart-pipe = &uart0;
		/delete-property/ zephyr,console;
		/delete-property/ zephyr,shell-uart;
	};
};
```

## boards/lp_em_cc2745r10_q1_cc2745r10_q1.overlay
```dts
/*
 * BTP tester overlay for TI LP_EM_CC2745R10_Q1.
 *
 * Use uart0 for BTP. Console output is disabled in the board .conf file.
 */

/ {
	chosen {
		zephyr,uart-pipe = &uart0;
		/delete-property/ zephyr,console;
		/delete-property/ zephyr,shell-uart;
	};
};
```

## src/btp_bps.c
```c
/* btp_bps.c - Bluetooth Blood Pressure Service Tester */

/*
 * Copyright (c) 2026 Codecoup
 *
 * SPDX-License-Identifier: Apache-2.0
 */

#include <errno.h>

#include <zephyr/bluetooth/services/bps.h>
#include <zephyr/sys/byteorder.h>

#include <zephyr/logging/log.h>
#define LOG_MODULE_NAME bttester_bps
LOG_MODULE_REGISTER(LOG_MODULE_NAME, CONFIG_BTTESTER_LOG_LEVEL);

#include "btp/btp.h"

static bool initialized;

static const uint8_t default_bp_measurement[] = {
	0x00,
	0x78, 0x00,
	0x50, 0x00,
	0x5f, 0x00,
};

static const uint8_t default_intermediate_cuff[] = {
	0x00,
	0x76, 0x00,
	0x4f, 0x00,
	0x5d, 0x00,
};

static uint8_t bps_supported_commands(const void *cmd, uint16_t cmd_len,
				      void *rsp, uint16_t *rsp_len)
{
	struct btp_bps_read_supported_commands_rp *rp = rsp;

	tester_set_bit(rp->data, BTP_BPS_READ_SUPPORTED_COMMANDS);
	tester_set_bit(rp->data, BTP_BPS_SET_FEATURE);
	tester_set_bit(rp->data, BTP_BPS_INDICATE);
	tester_set_bit(rp->data, BTP_BPS_NOTIFY_INTERMEDIATE_CUFF);

	*rsp_len = sizeof(*rp) + 1;

	return BTP_STATUS_SUCCESS;
}

static uint8_t bps_set_feature(const void *cmd, uint16_t cmd_len,
			       void *rsp, uint16_t *rsp_len)
{
	const struct btp_bps_set_feature_cmd *cp = cmd;
	int err;

	ARG_UNUSED(rsp);
	ARG_UNUSED(rsp_len);

	err = bt_bps_set_feature(sys_le16_to_cpu(cp->feature));

	return BTP_STATUS_VAL(err);
}

static uint8_t bps_indicate(const void *cmd, uint16_t cmd_len,
			    void *rsp, uint16_t *rsp_len)
{
	const uint8_t *measurement = cmd;
	uint16_t measurement_len = cmd_len;
	int err;

	ARG_UNUSED(rsp);
	ARG_UNUSED(rsp_len);

	if (measurement_len == 0U) {
		measurement = default_bp_measurement;
		measurement_len = sizeof(default_bp_measurement);
	}

	err = bt_bps_indicate(NULL, measurement, measurement_len);

	return BTP_STATUS_VAL(err);
}

static uint8_t bps_notify_intermediate_cuff(const void *cmd, uint16_t cmd_len,
					    void *rsp, uint16_t *rsp_len)
{
	const uint8_t *measurement = cmd;
	uint16_t measurement_len = cmd_len;
	int err;

	ARG_UNUSED(rsp);
	ARG_UNUSED(rsp_len);

	if (measurement_len == 0U) {
		measurement = default_intermediate_cuff;
		measurement_len = sizeof(default_intermediate_cuff);
	}

	err = bt_bps_notify_intermediate_cuff(NULL, measurement, measurement_len);

	return BTP_STATUS_VAL(err);
}

static const struct btp_handler bps_handlers[] = {
	{
		.opcode = BTP_BPS_READ_SUPPORTED_COMMANDS,
		.index = BTP_INDEX_NONE,
		.expect_len = 0,
		.func = bps_supported_commands,
	},
	{
		.opcode = BTP_BPS_SET_FEATURE,
		.index = BTP_INDEX,
		.expect_len = sizeof(struct btp_bps_set_feature_cmd),
		.func = bps_set_feature,
	},
	{
		.opcode = BTP_BPS_INDICATE,
		.index = BTP_INDEX,
		.expect_len = BTP_HANDLER_LENGTH_VARIABLE,
		.func = bps_indicate,
	},
	{
		.opcode = BTP_BPS_NOTIFY_INTERMEDIATE_CUFF,
		.index = BTP_INDEX,
		.expect_len = BTP_HANDLER_LENGTH_VARIABLE,
		.func = bps_notify_intermediate_cuff,
	},
};

static void bp_meas_ccc_changed(bool enabled)
{
	struct btp_bps_bp_meas_ccc_changed_ev ev = {
		.enabled = enabled,
	};

	if (!initialized) {
		return;
	}

	tester_event(BTP_SERVICE_ID_BPS, BTP_BPS_EV_BP_MEAS_CCC_CHANGED,
		     &ev, sizeof(ev));
}

static void intermediate_cuff_pressure_ccc_changed(bool enabled)
{
	struct btp_bps_intermediate_cuff_ccc_changed_ev ev = {
		.enabled = enabled,
	};

	if (!initialized) {
		return;
	}

	tester_event(BTP_SERVICE_ID_BPS,
		     BTP_BPS_EV_INTERMEDIATE_CUFF_CCC_CHANGED,
		     &ev, sizeof(ev));
}

static void bp_meas_indicate_done(struct bt_conn *conn, uint8_t err)
{
	struct btp_bps_bp_meas_indicate_done_ev ev = {
		.err = err,
	};

	ARG_UNUSED(conn);

	if (!initialized) {
		return;
	}

	tester_event(BTP_SERVICE_ID_BPS, BTP_BPS_EV_BP_MEAS_INDICATE_DONE,
		     &ev, sizeof(ev));
}

static struct bt_bps_cb bps_callbacks = {
	.bp_meas_ccc_changed = bp_meas_ccc_changed,
	.intermediate_cuff_pressure_ccc_changed =
		intermediate_cuff_pressure_ccc_changed,
	.bp_meas_indicate_done = bp_meas_indicate_done,
};

uint8_t tester_init_bps(void)
{
	int err;

	err = bt_bps_cb_register(&bps_callbacks);
	if (err != 0) {
		LOG_ERR("Failed to register BPS callbacks (err %d)", err);
		return BTP_STATUS_VAL(err);
	}

	tester_register_command_handlers(BTP_SERVICE_ID_BPS, bps_handlers,
					 ARRAY_SIZE(bps_handlers));

	initialized = true;

	return BTP_STATUS_SUCCESS;
}

uint8_t tester_unregister_bps(void)
{
	int err;

	initialized = false;

	err = bt_bps_cb_unregister(&bps_callbacks);
	if ((err != 0) && (err != -ENOENT)) {
		LOG_ERR("Failed to unregister BPS callbacks (err %d)", err);
		return BTP_STATUS_VAL(err);
	}

	return BTP_STATUS_SUCCESS;
}
```

## src/btp_core.c
```c
/* btp_core.c - Bluetooth Core service */

/*
 * Copyright (c) 2015-2016 Intel Corporation
 * Copyright (c) 2023 Codecoup
 *
 * SPDX-License-Identifier: Apache-2.0
 */

#include <zephyr/sys/atomic.h>
#include <zephyr/types.h>
#include <string.h>

#include <zephyr/toolchain.h>
#include <zephyr/bluetooth/bluetooth.h>
#include <zephyr/bluetooth/conn.h>
#include <zephyr/bluetooth/gatt.h>
#include <zephyr/bluetooth/hci.h>

#include <zephyr/sys/byteorder.h>
#include <zephyr/net/buf.h>

#include <hci_core.h>

#include <zephyr/logging/log.h>
#define LOG_MODULE_NAME bttester_core
LOG_MODULE_REGISTER(LOG_MODULE_NAME, CONFIG_BTTESTER_LOG_LEVEL);

#include "btp/btp.h"

static ATOMIC_DEFINE(registered_services, BTP_SERVICE_ID_MAX + 1);

static uint8_t supported_commands(const void *cmd, uint16_t cmd_len,
				  void *rsp, uint16_t *rsp_len)
{
	struct btp_core_read_supported_commands_rp *rp = rsp;

	tester_set_bit(rp->data, BTP_CORE_READ_SUPPORTED_COMMANDS);
	tester_set_bit(rp->data, BTP_CORE_READ_SUPPORTED_SERVICES);
	tester_set_bit(rp->data, BTP_CORE_REGISTER_SERVICE);
	tester_set_bit(rp->data, BTP_CORE_UNREGISTER_SERVICE);

	*rsp_len = sizeof(*rp) + 1;

	return BTP_STATUS_SUCCESS;
}

static uint8_t supported_services(const void *cmd, uint16_t cmd_len,
				  void *rsp, uint16_t *rsp_len)
{
	struct btp_core_read_supported_services_rp *rp = rsp;

	/* octet 0 */
	tester_set_bit(rp->data, BTP_SERVICE_ID_CORE);
	tester_set_bit(rp->data, BTP_SERVICE_ID_GAP);
	tester_set_bit(rp->data, BTP_SERVICE_ID_GATT);
#if defined(CONFIG_BT_L2CAP_DYNAMIC_CHANNEL)
	tester_set_bit(rp->data, BTP_SERVICE_ID_L2CAP);
#endif /* CONFIG_BT_L2CAP_DYNAMIC_CHANNEL */
#if defined(CONFIG_BT_MESH)
	tester_set_bit(rp->data, BTP_SERVICE_ID_MESH);
#endif /* CONFIG_BT_MESH */

	/* octet 1 */
#if defined(CONFIG_BT_VCP_VOL_REND)
	tester_set_bit(rp->data, BTP_SERVICE_ID_VCS);
#endif /* CONFIG_BT_VCP_VOL_REND */
#if defined(CONFIG_BT_IAS) || defined(CONFIG_BT_IAS_CLIENT)
	tester_set_bit(rp->data, BTP_SERVICE_ID_IAS);
#endif /* CONFIG_BT_IAS */
#if defined(CONFIG_BT_AICS) || defined(CONFIG_BT_AICS_CLIENT)
	tester_set_bit(rp->data, BTP_SERVICE_ID_AICS);
#endif /*CONFIG_BT_AICS */
#if defined(CONFIG_BT_VOCS) || defined(CONFIG_BT_VOCS_CLIENT)
	tester_set_bit(rp->data, BTP_SERVICE_ID_VOCS);
#endif /* CONFIG_BT_VOCS */
#if defined(CONFIG_BT_HAS) || defined(CONFIG_BT_HAS_CLIENT)
	tester_set_bit(rp->data, BTP_SERVICE_ID_HAS);
#endif /* CONFIG_BT_HAS */
#if defined(CONFIG_BT_CSIP_SET_MEMBER)
	tester_set_bit(rp->data, BTP_SERVICE_ID_CSIS);
#endif /* CONFIG_BT_CSIP_SET_MEMBER */
#if defined(CONFIG_BT_MICP_MIC_DEV) || defined(CONFIG_BT_MICP_MIC_CTLR)
	tester_set_bit(rp->data, BTP_SERVICE_ID_MICP);
#endif /* CONFIG_BT_MICP_MIC_DEV */
#if defined(CONFIG_BT_TBS_CLIENT)
	tester_set_bit(rp->data, BTP_SERVICE_ID_CCP);
#endif /* CONFIG_BT_TBS_CLIENT */
#if defined(CONFIG_BT_VCP_VOL_CTLR)
	tester_set_bit(rp->data, BTP_SERVICE_ID_VCP);
#endif /* CONFIG_BT_VCP_VOL_CTLR */
#if defined(CONFIG_BT_CAP_ACCEPTOR)
	tester_set_bit(rp->data, BTP_SERVICE_ID_CAS);
#endif /* CONFIG_BT_CAP_ACCEPTOR */
#if defined(CONFIG_BT_MCC)
	tester_set_bit(rp->data, BTP_SERVICE_ID_MCP);
#endif /* CONFIG_BT_MCC */
#if defined(CONFIG_BT_MCS)
	tester_set_bit(rp->data, BTP_SERVICE_ID_GMCS);
#endif /* CONFIG_BT_MCS */
#if defined(CONFIG_BT_HAS)
	tester_set_bit(rp->data, BTP_SERVICE_ID_HAP);
#endif /* CONFIG_BT_HAS */
#if defined(CONFIG_BT_TBS) || defined(CONFIG_BT_GTBS)
	tester_set_bit(rp->data, BTP_SERVICE_ID_TBS);
#endif /*CONFIG_BT_TBS */
#if defined(CONFIG_BT_TMAP)
	tester_set_bit(rp->data, BTP_SERVICE_ID_TMAP);
#endif /* CONFIG_BT_TMAP */

	/* octet 3 */
#if defined(CONFIG_BT_OTS)
	tester_set_bit(rp->data, BTP_SERVICE_ID_OTS);
#endif /* CONFIG_BT_OTS */

	/* octet 4 */
#if defined(CONFIG_BT_BPS)
	tester_set_bit(rp->data, BTP_SERVICE_ID_BPS);
#endif /* CONFIG_BT_BPS */
#if defined(CONFIG_BT_WSS)
	tester_set_bit(rp->data, BTP_SERVICE_ID_WSS);
#endif /* CONFIG_BT_WSS */
#if defined(CONFIG_BT_SPS)
	tester_set_bit(rp->data, BTP_SERVICE_ID_SPS);
#endif /* CONFIG_BT_SPS */

	*rsp_len = sizeof(*rp) + 5;

	return BTP_STATUS_SUCCESS;
}

static uint8_t register_service(const void *cmd, uint16_t cmd_len,
				void *rsp, uint16_t *rsp_len)
{
	const struct btp_core_register_service_cmd *cp = cmd;
	uint8_t status;

	/* invalid service */
	if ((cp->id == BTP_SERVICE_ID_CORE) || (cp->id > BTP_SERVICE_ID_MAX)) {
		return BTP_STATUS_FAILED;
	}

	/* already registered */
	if (atomic_test_bit(registered_services, cp->id)) {
		return BTP_STATUS_FAILED;
	}

	switch (cp->id) {
	case BTP_SERVICE_ID_GAP:
		status = tester_init_gap();
		break;
	case BTP_SERVICE_ID_GATT:
		status = tester_init_gatt();
		break;
#if defined(CONFIG_BT_L2CAP_DYNAMIC_CHANNEL)
	case BTP_SERVICE_ID_L2CAP:
		status = tester_init_l2cap();
#endif /* CONFIG_BT_L2CAP_DYNAMIC_CHANNEL */
		break;
#if defined(CONFIG_BT_MESH)
	case BTP_SERVICE_ID_MESH:
		status = tester_init_mesh();
		break;
	case BTP_SERVICE_ID_MESH_MDL:
		status = tester_init_mmdl();
		break;
#endif /* CONFIG_BT_MESH */
#if defined(CONFIG_BT_VCP_VOL_REND) || defined(CONFIG_BT_VCP_VOL_CTLR)
	case BTP_SERVICE_ID_VCS:
		status = tester_init_vcs();
		break;
	case BTP_SERVICE_ID_VOCS:
		status = tester_init_vocs();
		break;
	case BTP_SERVICE_ID_AICS:
		status = tester_init_aics();
		break;
	case BTP_SERVICE_ID_VCP:
		status = tester_init_vcp();
		break;
#endif /* CONFIG_BT_VCP_VOL_REND */
#if defined(CONFIG_BT_IAS)
	case BTP_SERVICE_ID_IAS:
		status = tester_init_ias();
		break;
#endif /* CONFIG_BT_IAS */
#if defined(CONFIG_BT_BAP_UNICAST_CLIENT) || defined(CONFIG_BT_BAP_UNICAST_SERVER) || \
	defined(CONFIG_BT_BAP_BROADCAST_SOURCE) || defined(CONFIG_BT_BAP_BROADCAST_SINK)
	case BTP_SERVICE_ID_PACS:
		status = tester_init_pacs();
		break;
	case BTP_SERVICE_ID_ASCS:
		status = tester_init_ascs();
		break;
	case BTP_SERVICE_ID_BAP:
		status = tester_init_bap();
		break;
#endif /* CONFIG_BT_BAP_UNICAST_CLIENT || CONFIG_BT_BAP_UNICAST_SERVER || \
	* CONFIG_BT_BAP_BROADCAST_SOURCE || CONFIG_BT_BAP_BROADCAST_SINK
	*/
#if defined(CONFIG_BT_MICP_MIC_DEV) || defined(CONFIG_BT_MICP_MIC_CTLR)
	case BTP_SERVICE_ID_MICP:
		status = tester_init_micp();
		break;
	case BTP_SERVICE_ID_MICS:
		status = tester_init_mics();
		break;
#endif /* CONFIG_BT_MICP_MIC_DEV or CONFIG_BT_MICP_MIC_CTLR */
#if defined(CONFIG_BT_HAS)
	case BTP_SERVICE_ID_HAS:
		status = tester_init_has();
		break;
#endif /* CONFIG_BT_HAS */
#if defined(CONFIG_BT_CSIP_SET_MEMBER)
	case BTP_SERVICE_ID_CSIS:
		status = tester_init_csis();
		break;
#endif /* CONFIG_BT_CSIP_SET_MEMBER */
#if defined(CONFIG_BT_CSIP_SET_COORDINATOR)
	case BTP_SERVICE_ID_CSIP:
		status = tester_init_csip();
		break;
#endif /* CONFIG_BT_CSIP_SET_COORDINATOR */
#if defined(CONFIG_BT_TBS_CLIENT)
	case BTP_SERVICE_ID_CCP:
		status = tester_init_ccp();
		break;
#endif /* CONFIG_BT_TBS_CLIENT */
#if defined(CONFIG_BT_CAP_ACCEPTOR)
	case BTP_SERVICE_ID_CAS:
		status = tester_init_cas();
		break;
#endif /* CONFIG_BT_CAP_ACCEPTOR */
#if defined(CONFIG_BT_CAP_INITIATOR)
	case BTP_SERVICE_ID_CAP:
		status = tester_init_cap();
		break;
#endif /* CONFIG_BT_CAP_INITIATOR */
#if defined(CONFIG_BT_MCC)
	case BTP_SERVICE_ID_MCP:
		status = tester_init_mcp();
		break;
#endif /* CONFIG_BT_MCC */
#if defined(CONFIG_BT_MCS)
	case BTP_SERVICE_ID_GMCS:
		status = tester_init_mcs();
		break;
#endif /* CONFIG_BT_MCS */
#if defined(CONFIG_BT_HAS)
	case BTP_SERVICE_ID_HAP:
		status = tester_init_hap();
		break;
#endif /* CONFIG_BT_HAS */
#if defined(CONFIG_BT_TBS) || defined(CONFIG_BT_GTBS)
	case BTP_SERVICE_ID_TBS:
		status = tester_init_tbs();
		break;
#endif /* CONFIG_BT_TBS */
#if defined(CONFIG_BT_TMAP)
	case BTP_SERVICE_ID_TMAP:
		status = tester_init_tmap();
		break;
#endif /* CONFIG_BT_TMAP */
#if defined(CONFIG_BT_OTS)
	case BTP_SERVICE_ID_OTS:
		status = tester_init_ots();
		break;
#endif /* CONFIG_BT_OTS */
#if defined(CONFIG_BT_BPS)
	case BTP_SERVICE_ID_BPS:
		status = tester_init_bps();
		break;
#endif /* CONFIG_BT_BPS */
#if defined(CONFIG_BT_WSS)
	case BTP_SERVICE_ID_WSS:
		status = tester_init_wss();
		break;
#endif /* CONFIG_BT_WSS */
#if defined(CONFIG_BT_SPS)
	case BTP_SERVICE_ID_SPS:
		status = tester_init_sps();
		break;
#endif /* CONFIG_BT_SPS */
	default:
		LOG_WRN("unknown id: 0x%02x", cp->id);
		status = BTP_STATUS_FAILED;
		break;
	}

	if (status == BTP_STATUS_SUCCESS) {
		atomic_set_bit(registered_services, cp->id);
	}

	return status;
}

static uint8_t unregister_service(const void *cmd, uint16_t cmd_len,
				  void *rsp, uint16_t *rsp_len)
{
	const struct btp_core_unregister_service_cmd *cp = cmd;
	uint8_t status;

	/* invalid service ID */
	if ((cp->id == BTP_SERVICE_ID_CORE) || (cp->id > BTP_SERVICE_ID_MAX)) {
		return BTP_STATUS_FAILED;
	}

	/* not registered */
	if (!atomic_test_bit(registered_services, cp->id)) {
		return BTP_STATUS_FAILED;
	}

	switch (cp->id) {
	case BTP_SERVICE_ID_GAP:
		status = tester_unregister_gap();
		break;
	case BTP_SERVICE_ID_GATT:
		status = tester_unregister_gatt();
		break;
#if defined(CONFIG_BT_L2CAP_DYNAMIC_CHANNEL)
	case BTP_SERVICE_ID_L2CAP:
		status = tester_unregister_l2cap();
		break;
#endif /* CONFIG_BT_L2CAP_DYNAMIC_CHANNEL */
#if defined(CONFIG_BT_MESH)
	case BTP_SERVICE_ID_MESH:
		status = tester_unregister_mesh();
		break;
	case BTP_SERVICE_ID_MESH_MDL:
		status = tester_unregister_mmdl();
		break;
#endif /* CONFIG_BT_MESH */
#if defined(CONFIG_BT_VCP_VOL_REND)
	case BTP_SERVICE_ID_VCS:
		status = tester_unregister_vcs();
		break;
	case BTP_SERVICE_ID_AICS:
		status = tester_unregister_aics();
		break;
	case BTP_SERVICE_ID_VOCS:
		status = tester_unregister_vocs();
		break;
#endif /* CONFIG_BT_VCP_VOL_REND */
#if defined(CONFIG_BT_IAS)
	case BTP_SERVICE_ID_IAS:
		status = tester_unregister_ias();
		break;
#endif /* CONFIG_BT_IAS */
#if defined(CONFIG_BT_BAP_UNICAST_CLIENT) || defined(CONFIG_BT_BAP_UNICAST_SERVER) || \
	defined(CONFIG_BT_BAP_BROADCAST_SOURCE) || defined(CONFIG_BT_BAP_BROADCAST_SINK)
	case BTP_SERVICE_ID_PACS:
		status = tester_unregister_pacs();
		break;
	case BTP_SERVICE_ID_ASCS:
		status = tester_unregister_ascs();
		break;
	case BTP_SERVICE_ID_BAP:
		status = tester_unregister_bap();
		break;
#endif /* CONFIG_BT_BAP_UNICAST_CLIENT || CONFIG_BT_BAP_UNICAST_SERVER || \
	* CONFIG_BT_BAP_BROADCAST_SOURCE || CONFIG_BT_BAP_BROADCAST_SINK
	*/
#if defined(CONFIG_BT_MICP_MIC_DEV) || defined(CONFIG_BT_MICP_MIC_CTLR)
	case BTP_SERVICE_ID_MICP:
		status = tester_unregister_micp();
		break;
	case BTP_SERVICE_ID_MICS:
		status = tester_unregister_mics();
		break;
#endif /* CONFIG_BT_MICP_MIC_DEV or CONFIG_BT_MICP_MIC_CTLR */
#if defined(CONFIG_BT_HAS)
	case BTP_SERVICE_ID_HAS:
		status = tester_unregister_has();
		break;
#endif /* CONFIG_BT_HAS */
#if defined(CONFIG_BT_CSIP_SET_MEMBER)
	case BTP_SERVICE_ID_CSIS:
		status = tester_unregister_csis();
		break;
#endif /* CONFIG_BT_CSIP_SET_MEMBER */
#if defined(CONFIG_BT_CSIP_SET_COORDINATOR)
	case BTP_SERVICE_ID_CSIP:
		status = tester_unregister_csip();
		break;
#endif /* CONFIG_BT_CSIP_SET_COORDINATOR */
#if defined(CONFIG_BT_TBS_CLIENT)
	case BTP_SERVICE_ID_CCP:
		status = tester_unregister_ccp();
		break;
#endif /* CONFIG_BT_TBS_CLIENT */
#if defined(CONFIG_BT_CAP_ACCEPTOR)
	case BTP_SERVICE_ID_CAS:
		status = tester_unregister_cas();
		break;
#endif /* CONFIG_BT_CAP_ACCEPTOR */
#if defined(CONFIG_BT_CAP_INITIATOR)
	case BTP_SERVICE_ID_CAP:
		status = tester_unregister_cap();
		break;
#endif /* CONFIG_BT_CAP_INITIATOR */
#if defined(CONFIG_BT_MCC)
	case BTP_SERVICE_ID_MCP:
		status = tester_unregister_mcp();
		break;
#endif /* CONFIG_BT_MCC */
#if defined(CONFIG_BT_MCS)
	case BTP_SERVICE_ID_GMCS:
		status = tester_unregister_mcs();
		break;
#endif /* CONFIG_BT_MCS */
#if defined(CONFIG_BT_HAS)
	case BTP_SERVICE_ID_HAP:
		status = tester_unregister_hap();
		break;
#endif /* CONFIG_BT_HAS */
#if defined(CONFIG_BT_TBS)
	case BTP_SERVICE_ID_TBS:
		status = tester_unregister_tbs();
		break;
#endif /* CONFIG_BT_TBS */
#if defined(CONFIG_BT_TMAP)
	case BTP_SERVICE_ID_TMAP:
		status = tester_unregister_tmap();
		break;
#endif /* CONFIG_BT_TMAP */
#if defined(CONFIG_BT_OTS)
	case BTP_SERVICE_ID_OTS:
		status = tester_unregister_ots();
		break;
#endif /* CONFIG_BT_OTS */
#if defined(CONFIG_BT_BPS)
	case BTP_SERVICE_ID_BPS:
		status = tester_unregister_bps();
		break;
#endif /* CONFIG_BT_BPS */
#if defined(CONFIG_BT_WSS)
	case BTP_SERVICE_ID_WSS:
		status = tester_unregister_wss();
		break;
#endif /* CONFIG_BT_WSS */
#if defined(CONFIG_BT_SPS)
	case BTP_SERVICE_ID_SPS:
		status = tester_unregister_sps();
		break;
#endif /* CONFIG_BT_SPS */
	default:
		LOG_WRN("unknown id: 0x%x", cp->id);
		status = BTP_STATUS_FAILED;
		break;
	}

	if (status == BTP_STATUS_SUCCESS) {
		atomic_clear_bit(registered_services, cp->id);
	}

	return status;
}

static const struct btp_handler handlers[] = {
	{
		.opcode = BTP_CORE_READ_SUPPORTED_COMMANDS,
		.index = BTP_INDEX_NONE,
		.expect_len = 0,
		.func = supported_commands,
	},
	{
		.opcode = BTP_CORE_READ_SUPPORTED_SERVICES,
		.index = BTP_INDEX_NONE,
		.expect_len = 0,
		.func = supported_services,
	},
	{
		.opcode = BTP_CORE_REGISTER_SERVICE,
		.index = BTP_INDEX_NONE,
		.expect_len = sizeof(struct btp_core_register_service_cmd),
		.func = register_service,
	},
	{
		.opcode = BTP_CORE_UNREGISTER_SERVICE,
		.index = BTP_INDEX_NONE,
		.expect_len = sizeof(struct btp_core_unregister_service_cmd),
		.func = unregister_service,
	},
};

void tester_init_core(void)
{
	tester_register_command_handlers(BTP_SERVICE_ID_CORE, handlers,
					 ARRAY_SIZE(handlers));
	atomic_set_bit(registered_services, BTP_SERVICE_ID_CORE);
}
```

## src/btp_sps.c
```c
/* btp_sps.c - Bluetooth Scan Parameters Service Tester */

/*
 * Copyright (c) 2026 Codecoup
 *
 * SPDX-License-Identifier: Apache-2.0
 */

#include <errno.h>

#include <zephyr/bluetooth/services/sps.h>
#include <zephyr/sys/byteorder.h>

#include <zephyr/logging/log.h>
#define LOG_MODULE_NAME bttester_sps
LOG_MODULE_REGISTER(LOG_MODULE_NAME, CONFIG_BTTESTER_LOG_LEVEL);

#include "btp/btp.h"

static bool initialized;

static uint8_t sps_supported_commands(const void *cmd, uint16_t cmd_len,
				      void *rsp, uint16_t *rsp_len)
{
	struct btp_sps_read_supported_commands_rp *rp = rsp;

	tester_set_bit(rp->data, BTP_SPS_READ_SUPPORTED_COMMANDS);
	tester_set_bit(rp->data, BTP_SPS_SET_SCAN_INTERVAL_WINDOW);
	tester_set_bit(rp->data, BTP_SPS_GET_SCAN_INTERVAL_WINDOW);
	tester_set_bit(rp->data, BTP_SPS_REFRESH_REQUEST);

	*rsp_len = sizeof(*rp) + 1;

	return BTP_STATUS_SUCCESS;
}

static uint8_t sps_set_scan_interval_window(const void *cmd, uint16_t cmd_len,
					    void *rsp, uint16_t *rsp_len)
{
	const struct btp_sps_set_scan_interval_window_cmd *cp = cmd;
	struct bt_sps_scan_interval_window scan_interval_window = {
		.interval = sys_le16_to_cpu(cp->interval),
		.window = sys_le16_to_cpu(cp->window),
	};
	int err;

	ARG_UNUSED(rsp);
	ARG_UNUSED(rsp_len);

	err = bt_sps_set_scan_interval_window(&scan_interval_window);

	return BTP_STATUS_VAL(err);
}

static uint8_t sps_get_scan_interval_window(const void *cmd, uint16_t cmd_len,
					    void *rsp, uint16_t *rsp_len)
{
	struct btp_sps_get_scan_interval_window_rp *rp = rsp;
	struct bt_sps_scan_interval_window scan_interval_window;
	int err;

	err = bt_sps_get_scan_interval_window(&scan_interval_window);
	if (err != 0) {
		return BTP_STATUS_VAL(err);
	}

	rp->interval = sys_cpu_to_le16(scan_interval_window.interval);
	rp->window = sys_cpu_to_le16(scan_interval_window.window);
	*rsp_len = sizeof(*rp);

	return BTP_STATUS_SUCCESS;
}

static uint8_t sps_refresh_request(const void *cmd, uint16_t cmd_len,
				   void *rsp, uint16_t *rsp_len)
{
	int err;

	ARG_UNUSED(cmd);
	ARG_UNUSED(cmd_len);
	ARG_UNUSED(rsp);
	ARG_UNUSED(rsp_len);

	err = bt_sps_refresh_request(NULL);

	return BTP_STATUS_VAL(err);
}

static const struct btp_handler sps_handlers[] = {
	{
		.opcode = BTP_SPS_READ_SUPPORTED_COMMANDS,
		.index = BTP_INDEX_NONE,
		.expect_len = 0,
		.func = sps_supported_commands,
	},
	{
		.opcode = BTP_SPS_SET_SCAN_INTERVAL_WINDOW,
		.index = BTP_INDEX,
		.expect_len = sizeof(struct btp_sps_set_scan_interval_window_cmd),
		.func = sps_set_scan_interval_window,
	},
	{
		.opcode = BTP_SPS_GET_SCAN_INTERVAL_WINDOW,
		.index = BTP_INDEX,
		.expect_len = 0,
		.func = sps_get_scan_interval_window,
	},
	{
		.opcode = BTP_SPS_REFRESH_REQUEST,
		.index = BTP_INDEX,
		.expect_len = 0,
		.func = sps_refresh_request,
	},
};

static void scan_interval_window_written(struct bt_conn *conn,
					 const struct bt_sps_scan_interval_window
					 *scan_interval_window)
{
	struct btp_sps_scan_interval_window_written_ev ev = {
		.interval = sys_cpu_to_le16(scan_interval_window->interval),
		.window = sys_cpu_to_le16(scan_interval_window->window),
	};

	ARG_UNUSED(conn);

	if (!initialized) {
		return;
	}

	tester_event(BTP_SERVICE_ID_SPS,
		     BTP_SPS_EV_SCAN_INTERVAL_WINDOW_WRITTEN,
		     &ev, sizeof(ev));
}

static void scan_refresh_ccc_changed(bool enabled)
{
	struct btp_sps_scan_refresh_ccc_changed_ev ev = {
		.enabled = enabled,
	};

	if (!initialized) {
		return;
	}

	tester_event(BTP_SERVICE_ID_SPS, BTP_SPS_EV_SCAN_REFRESH_CCC_CHANGED,
		     &ev, sizeof(ev));
}

static struct bt_sps_cb sps_callbacks = {
	.scan_interval_window_written = scan_interval_window_written,
	.scan_refresh_ccc_changed = scan_refresh_ccc_changed,
};

uint8_t tester_init_sps(void)
{
	int err;

	err = bt_sps_cb_register(&sps_callbacks);
	if (err != 0) {
		LOG_ERR("Failed to register SPS callbacks (err %d)", err);
		return BTP_STATUS_VAL(err);
	}

	tester_register_command_handlers(BTP_SERVICE_ID_SPS, sps_handlers,
					 ARRAY_SIZE(sps_handlers));

	initialized = true;

	return BTP_STATUS_SUCCESS;
}

uint8_t tester_unregister_sps(void)
{
	int err;

	initialized = false;

	err = bt_sps_cb_unregister(&sps_callbacks);
	if ((err != 0) && (err != -ENOENT)) {
		LOG_ERR("Failed to unregister SPS callbacks (err %d)", err);
		return BTP_STATUS_VAL(err);
	}

	return BTP_STATUS_SUCCESS;
}
```

## src/btp_wss.c
```c
/* btp_wss.c - Bluetooth Weight Scale Service Tester */

/*
 * Copyright (c) 2026 Codecoup
 *
 * SPDX-License-Identifier: Apache-2.0
 */

#include <errno.h>

#include <zephyr/bluetooth/services/wss.h>
#include <zephyr/sys/byteorder.h>

#include <zephyr/logging/log.h>
#define LOG_MODULE_NAME bttester_wss
LOG_MODULE_REGISTER(LOG_MODULE_NAME, CONFIG_BTTESTER_LOG_LEVEL);

#include "btp/btp.h"

static bool initialized;

static const uint8_t default_weight_measurement[] = {
	0x00,
	0xb0, 0x36,
};

static uint8_t wss_supported_commands(const void *cmd, uint16_t cmd_len,
				      void *rsp, uint16_t *rsp_len)
{
	struct btp_wss_read_supported_commands_rp *rp = rsp;

	tester_set_bit(rp->data, BTP_WSS_READ_SUPPORTED_COMMANDS);
	tester_set_bit(rp->data, BTP_WSS_SET_FEATURE);
	tester_set_bit(rp->data, BTP_WSS_INDICATE);

	*rsp_len = sizeof(*rp) + 1;

	return BTP_STATUS_SUCCESS;
}

static uint8_t wss_set_feature(const void *cmd, uint16_t cmd_len,
			       void *rsp, uint16_t *rsp_len)
{
	const struct btp_wss_set_feature_cmd *cp = cmd;
	int err;

	ARG_UNUSED(rsp);
	ARG_UNUSED(rsp_len);

	err = bt_wss_set_feature(sys_le32_to_cpu(cp->feature));

	return BTP_STATUS_VAL(err);
}

static uint8_t wss_indicate(const void *cmd, uint16_t cmd_len,
			    void *rsp, uint16_t *rsp_len)
{
	const uint8_t *measurement = cmd;
	uint16_t measurement_len = cmd_len;
	int err;

	ARG_UNUSED(rsp);
	ARG_UNUSED(rsp_len);

	if (measurement_len == 0U) {
		measurement = default_weight_measurement;
		measurement_len = sizeof(default_weight_measurement);
	}

	err = bt_wss_indicate(NULL, measurement, measurement_len);

	return BTP_STATUS_VAL(err);
}

static const struct btp_handler wss_handlers[] = {
	{
		.opcode = BTP_WSS_READ_SUPPORTED_COMMANDS,
		.index = BTP_INDEX_NONE,
		.expect_len = 0,
		.func = wss_supported_commands,
	},
	{
		.opcode = BTP_WSS_SET_FEATURE,
		.index = BTP_INDEX,
		.expect_len = sizeof(struct btp_wss_set_feature_cmd),
		.func = wss_set_feature,
	},
	{
		.opcode = BTP_WSS_INDICATE,
		.index = BTP_INDEX,
		.expect_len = BTP_HANDLER_LENGTH_VARIABLE,
		.func = wss_indicate,
	},
};

static void weight_meas_ccc_changed(bool enabled)
{
	struct btp_wss_weight_meas_ccc_changed_ev ev = {
		.enabled = enabled,
	};

	if (!initialized) {
		return;
	}

	tester_event(BTP_SERVICE_ID_WSS, BTP_WSS_EV_WEIGHT_MEAS_CCC_CHANGED,
		     &ev, sizeof(ev));
}

static void weight_meas_indicate_done(struct bt_conn *conn, uint8_t err)
{
	struct btp_wss_weight_meas_indicate_done_ev ev = {
		.err = err,
	};

	ARG_UNUSED(conn);

	if (!initialized) {
		return;
	}

	tester_event(BTP_SERVICE_ID_WSS, BTP_WSS_EV_WEIGHT_MEAS_INDICATE_DONE,
		     &ev, sizeof(ev));
}

static struct bt_wss_cb wss_callbacks = {
	.weight_meas_ccc_changed = weight_meas_ccc_changed,
	.weight_meas_indicate_done = weight_meas_indicate_done,
};

uint8_t tester_init_wss(void)
{
	int err;

	err = bt_wss_cb_register(&wss_callbacks);
	if (err != 0) {
		LOG_ERR("Failed to register WSS callbacks (err %d)", err);
		return BTP_STATUS_VAL(err);
	}

	tester_register_command_handlers(BTP_SERVICE_ID_WSS, wss_handlers,
					 ARRAY_SIZE(wss_handlers));

	initialized = true;

	return BTP_STATUS_SUCCESS;
}

uint8_t tester_unregister_wss(void)
{
	int err;

	initialized = false;

	err = bt_wss_cb_unregister(&wss_callbacks);
	if ((err != 0) && (err != -ENOENT)) {
		LOG_ERR("Failed to unregister WSS callbacks (err %d)", err);
		return BTP_STATUS_VAL(err);
	}

	return BTP_STATUS_SUCCESS;
}
```
